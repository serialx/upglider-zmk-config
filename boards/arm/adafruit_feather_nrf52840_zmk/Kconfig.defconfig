## boards/arm/adafruit_feather_nrf52840_zmk/Kconfig.defconfig
```kconfig
# BlueMicro840 board configuration

# Copyright (c) 2020 Pete Johanson, Derek Schmell
# SPDX-License-Identifier: MIT

if BOARD_ADAFRUIT_FEATHER_NRF52840_ZMK

config BOARD
	default "adafruit_feather_nrf52840_zmk"

if USB_DEVICE_STACK

config USB_NRFX
	default y

endif # USB_DEVICE_STACK

config BT_CTLR
	default BT

config ZMK_BLE
	default y

config ZMK_USB
	default y

config ZMK_BATTERY_VOLTAGE_DIVIDER
	default y

endif # BOARD_ADAFRUIT_FEATHER_NRF52840_ZMK
```

## config/boards/arm/adafruit_feather_nrf52840_zmk/Kconfig.board
```kconfig
# Adafruit Feather nRF52840 Express board configuration

# Copyright (c) 2020 Tobias Svehagen
# SPDX-License-Identifier: Apache-2.0

config BOARD_ADAFRUIT_FEATHER_NRF52840_ZMK
	bool "Adafruit Feather nRF52840 Express ZMK"
	depends on SOC_NRF52840_QIAA
```

## config/boards/arm/adafruit_feather_nrf52840_zmk/Kconfig.defconfig
```kconfig
# BlueMicro840 board configuration

# Copyright (c) 2020 Pete Johanson, Derek Schmell
# SPDX-License-Identifier: MIT

if BOARD_ADAFRUIT_FEATHER_NRF52840_ZMK

config BOARD
	default "adafruit_feather_nrf52840_zmk"

if USB

config USB_NRFX
	default y

config USB_DEVICE_STACK
	default y

endif # USB

config BT_CTLR
	default BT

config ZMK_BLE
	default y

config ZMK_USB
	default y

config ZMK_BATTERY_VOLTAGE_DIVIDER
	default y

endif # BOARD_ADAFRUIT_FEATHER_NRF52840_ZMK
```

## config/boards/shields/upglider/Kconfig.defconfig
```kconfig
if SHIELD_UPGLIDER

config ZMK_KEYBOARD_NAME
    default "Upglider YJ Mk I"

endif
```
